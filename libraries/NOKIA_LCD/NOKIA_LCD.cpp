#include "NOKIA_LCD.h"
#include <cstdarg>

#define STRING_STACK_LIMIT    120
// The 7-bit ASCII character set...
const uint8_t charset[][5] = {
  { 0x00, 0x00, 0x00, 0x00, 0x00 },  // 20 space
  { 0x00, 0x00, 0x5f, 0x00, 0x00 },  // 21 !
  { 0x00, 0x07, 0x00, 0x07, 0x00 },  // 22 "
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  { 0x00, 0x00, 0x00, 0x00, 0x00 }   // 7f
};

NOKIA_LCD::NOKIA_LCD(uint8_t mosi, uint8_t sclk, uint8_t cs, uint8_t dc, uint8_t rst) : mosiPin(mosi), sckPin(sclk), ssPin(cs), dcPin(dc), rstPin(rst) {
  height = 48;
  width = 84;
  column = 0;
  line = 0;
}

void NOKIA_LCD::send(uint8_t data){
  uint8_t i = 8;
  while(i--){
    if ((data & (1 << i)) != 0){
      digitalWrite(mosiPin, HIGH);
    } else {
      digitalWrite(mosiPin, LOW);
    }
    digitalWrite(sckPin, HIGH);
    digitalWrite(sckPin, HIGH);
    digitalWrite(sckPin, LOW);
    digitalWrite(sckPin, LOW);
  }
}

void NOKIA_LCD::sendData(uint8_t data){
  digitalWrite(ssPin, LOW);
  digitalWrite(dcPin, HIGH);
  send(data);
  digitalWrite(ssPin, HIGH);
}

void NOKIA_LCD::sendCmd(uint8_t data){
  digitalWrite(ssPin, LOW);
  digitalWrite(dcPin, LOW);
  send(data);
  digitalWrite(ssPin, HIGH);
}

void NOKIA_LCD::writeByte(uint8_t column, uint8_t line, uint8_t data){
  digitalWrite(ssPin, LOW);
  digitalWrite(dcPin, LOW);
  send(0x80 | (column % width));
  send(0x40 | (line % (height >> 3)));
  digitalWrite(dcPin, HIGH);
  send(data);
  digitalWrite(ssPin, HIGH);
}

void NOKIA_LCD::writeBuf(uint8_t column, uint8_t line, uint8_t *data, uint16_t len){
  digitalWrite(ssPin, LOW);
  digitalWrite(dcPin, LOW);
  send(0x80 | (column % width));
  send(0x40 | (line % (height >> 3)));
  digitalWrite(dcPin, HIGH);
  while(len--) send(*data++);
  digitalWrite(ssPin, HIGH);
}

void NOKIA_LCD::writeBuf(uint8_t *data){
  uint16_t len = width * (height / 8);
  digitalWrite(ssPin, LOW);
  digitalWrite(dcPin, LOW);
  send(0x80);
  send(0x40);
  digitalWrite(dcPin, HIGH);
  while(len--) send(*data++);
  digitalWrite(ssPin, HIGH);
}

void NOKIA_LCD::setCursor(uint8_t column, uint8_t line){
  column = (column % width);
  line = (line % (height/8));

  digitalWrite(ssPin, LOW);
  digitalWrite(dcPin, LOW);
  send(0x80 | column);
  send(0x40 | line);
  digitalWrite(ssPin, HIGH);
}

void NOKIA_LCD::clearLine(){
  column = 0;
  uint8_t chars = width;

  digitalWrite(ssPin, LOW);
  digitalWrite(dcPin, LOW);
  send(0x80);
  send(0x40 | line);
  digitalWrite(dcPin, HIGH);
  while (chars--) send(0x00);
  digitalWrite(dcPin, LOW);
  send(0x80);
  send(0x40 | line);
  digitalWrite(ssPin, HIGH);
}

void NOKIA_LCD::clear(){
  column = 0;
  line = 0;
  uint16_t chars = width * (height >> 3);

  digitalWrite(ssPin, LOW);
  digitalWrite(dcPin, LOW);
  send(0x80);
  send(0x40);
  digitalWrite(dcPin, HIGH);
  while (chars--) send(0x00);
  digitalWrite(dcPin, LOW);
  send(0x80);
  send(0x40);
  digitalWrite(ssPin, HIGH);
}

void NOKIA_LCD::begin(uint8_t model){
  pinMode(rstPin, OUTPUT);
  pinMode(ssPin, OUTPUT);
  pinMode(dcPin, OUTPUT);
  pinMode(mosiPin, OUTPUT);
  pinMode(sckPin, OUTPUT);
  
  digitalWrite(rstPin, HIGH);
  digitalWrite(ssPin, HIGH);
  digitalWrite(rstPin, LOW);
  delay(100);
  digitalWrite(rstPin, HIGH);

  digitalWrite(ssPin, LOW);
  digitalWrite(dcPin, LOW);

  // Set the LCD parameters...
  send(0x21);  // extended instruction set control (H=1)
  send(0x13);  // bias system (1:48)

  if (model == CHIP_ST7576) {
    send(0xe0);  // higher Vop, too faint at default
    send(0x05);  // partial display mode
  } else {
    send(0xc2);  // default Vop (3.06 + 66 * 0.06 = 7V)
  }

  send(0x20);  // extended instruction set control (H=0)
  send(0x09);  // all display segments on

  // Clear RAM contents...
  digitalWrite(dcPin, HIGH);
  uint16_t chars = width * (height >> 3);
  while (chars--) send(0x00);
  digitalWrite(dcPin, LOW);

  // Activate LCD...
  send(0x08);  // display blank
  send(0x0c);  // normal mode (0x0d = inverse mode)
  delay(100);

  // Place the cursor at the origin...
  send(0x80);
  send(0x40);
  digitalWrite(ssPin, HIGH);
}

void NOKIA_LCD::createChar(uint8_t chr, const uint8_t *glyph){
  if (chr > 31) return;
  custom[chr] = glyph;
}

void NOKIA_LCD::write(uint8_t chr){
    if (chr >= 0x80) return;
    const uint8_t *glyph;
    if (chr >= ' ') {
        glyph = charset[chr - ' '];
    } else {
        if (custom[chr]) {
            glyph = custom[chr];
        } else {
            glyph = charset[0];
        }
    }

    digitalWrite(ssPin, LOW);
    digitalWrite(dcPin, HIGH);
    for (uint8_t i = 0; i < 5; i++) send(glyph[i]);
    send(0x00);
    digitalWrite(ssPin, HIGH);

    column = (column + 6) % width;
    if (column == 0) {
        line = (line + 1) % (height/8);
    }
}

int NOKIA_LCD::write(const char *str) {
  while (*str) write(*str ++);
  return 0;
}

void NOKIA_LCD::drawBitmap(const uint8_t *data, uint8_t columns, uint8_t lines){
  uint8_t scolumn = column;
  uint8_t sline = line;
  uint8_t mx = (scolumn + columns > width) ? (width - scolumn) : columns;
  uint8_t my = (sline + lines > height/8) ? (height/8 - sline) : lines;

  digitalWrite(ssPin, LOW);
  for (uint8_t y = 0; y < my; y++) {
    digitalWrite(dcPin, LOW);
    send(0x80 | scolumn);
    send(0x40 | (sline + y));
    digitalWrite(dcPin, HIGH);
    for (uint8_t x = 0; x < mx; x++) {
      send(data[y * columns + x]);
    }
  }
  digitalWrite(dcPin, LOW);
  send(0x80 | (scolumn + columns));
  send(0x40 | sline);
  digitalWrite(ssPin, HIGH);

  column = scolumn + columns;
  line = sline;
}

void NOKIA_LCD::setPixel(uint8_t x, uint8_t y, bool value, bool writeIt = false){
  uint8_t column = (x % width);
  uint8_t line = ((y >> 3) % (height >> 3));
  uint16_t i = column + (line * width);
  if(value){
	  lcd_buffer[i] |= (1 << (y % 8));
  } else {
	  lcd_buffer[i] &= ~(1 << (y % 8));
  }

  if(writeIt) writeByte(column, line, (uint8_t)lcd_buffer[i]);
}

void NOKIA_LCD::draw(){
	writeBuf((uint8_t *)lcd_buffer);
}

inline void NOKIA_LCD::display(){
    sendCmd(0x20);
}

inline void NOKIA_LCD::noDisplay(){
    sendCmd(0x24);
}

void NOKIA_LCD::setPower(bool on){
    sendCmd(on ? 0x20 : 0x24);
}

void NOKIA_LCD::setInverse(bool inverse){
    sendCmd(inverse ? 0x0d : 0x0c);
}

void NOKIA_LCD::home(){
    setCursor(0, line);
}

void NOKIA_LCD::stop(){
    clear();
    noDisplay();
}
